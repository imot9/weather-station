## conf/bblayers.conf
```bitbake
# LAYER_CONF_VERSION is increased each time build/conf/bblayers.conf
# changes incompatibly
LCONF_VERSION = "7"

BBPATH = "${TOPDIR}"
BBFILES ?= ""

YOCTO_DIR ?= "/yocto"
BBLAYERS ?= " \
    ${YOCTO_DIR}/openembedded-core/meta \
    ${YOCTO_DIR}/meta-raspberrypi \
    ${YOCTO_DIR}/meta-openembedded/meta-oe \
    "
```

## conf/local.conf
```bitbake
MACHINE = "raspberrypi5"
DISTRO = "nodistro"
INHERIT += "rm_work"
IMAGE_INSTALL:append = "wpa-supplicant iw dropbear pciutils kernel-modules linux-firmware-rpidistro-bcm43455"
EXTRA_IMAGE_FEATURES ?= "allow-empty-password empty-root-password allow-root-login"
```
